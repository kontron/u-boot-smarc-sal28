## board/kontron/common/Kconfig
```kconfig
menu "Kontron ARM module extensions"

config CMD_KBOARDINFO
	bool "Enable Kontron 'kboardinfo' command"
	depends on !SPL_BUILD
	imply KBOARDINFO_MODULE
	help
	  This option enables the Kontron 'kboardinfo' command

config KBOARDINFO_MODULE
	bool

config EMB_EEP_I2C
	bool "Embedded I2C EEPROM support"
	depends on !SPL_BUILD
	help
	  This option enables embedded I2C EEPROM support for kboardinfo

config JAM_STAPL
	bool "JAM_STAPL kjtag driver support"
	depends on !SPL_BUILD
	help
	  This option enables kjtag JAM_STAPL driver

config EMB_EEP_I2C_BUS_NUM_EE1
	int "Embedded EEPROM I2C bus number"
	depends on EMB_EEP_I2C
	default 1

config EMB_EEP_I2C_ADDR_LEN_1
	int "Embedded EEPROM I2C address length"
	depends on EMB_EEP_I2C
	default 2

config EMB_EEP_I2C_ADDR_1
	hex "Embedded EEPROM I2C address"
	depends on EMB_EEP_I2C
	default 0x50

config EMB_EEP_I2C_OFFSET_1
	hex "Embedded I2C EEPROM data area offset"
	depends on EMB_EEP_I2C
	default 0x0

config EMB_EEP_I2C_SIZE
	hex "Embedded I2C EEPROM size"
	depends on EMB_EEP_I2C
	default 0x1000

endmenu
```

## board/kontron/sl28/Kconfig
```kconfig
if TARGET_SL28

config SYS_BOARD
	default "sl28"

config SYS_VENDOR
	default "kontron"

config SYS_SOC
	default "fsl-layerscape"

config SYS_CONFIG_NAME
	default "kontron_sl28"

config SYS_TEXT_BASE
	default 0x96000000

config KONTRON_TEST_EXTENSIONS
	bool "Kontron Test Extensions"
	default n
	help
	  This activates environment settings to be used inside Kontrons test
	  lab.

if FSL_LS_PPA
config SYS_LS_PPA_FW_ADDR
	hex "PPA Firmware Addr"
	default 0x20140000 if SYS_LS_PPA_FW_IN_XIP && ARCH_LS1028A
	default 0x00400000 if SYS_LS_PPA_FW_IN_MMC && ARCH_LS1028A
endif

source "board/kontron/common/Kconfig"

endif
```

## configs/kontron_sl28_defconfig
```kconfig
CONFIG_ARM=y
CONFIG_ARM_SMCCC=y
CONFIG_TARGET_SL28=y
CONFIG_SPL_GPIO_SUPPORT=y
CONFIG_SPL_LIBCOMMON_SUPPORT=y
CONFIG_SPL_LIBGENERIC_SUPPORT=y
CONFIG_SYS_MALLOC_F_LEN=0x4000
CONFIG_ENV_SIZE=0x2000
CONFIG_ENV_SECT_SIZE=0x10000
CONFIG_ENV_OFFSET=0x3e0000
CONFIG_DM_GPIO=y
CONFIG_SYS_FSL_SDHC_CLK_DIV=1
CONFIG_SPL_MMC_SUPPORT=y
CONFIG_SPL_SERIAL_SUPPORT=y
CONFIG_NR_DRAM_BANKS=2
CONFIG_SPL=y
CONFIG_ENV_OFFSET_REDUND=0x3f0000
CONFIG_SPL_SPI_FLASH_SUPPORT=y
CONFIG_SPL_SPI_SUPPORT=y
CONFIG_ARMV8_PSCI=y
CONFIG_CMD_KBOARDINFO=y
CONFIG_EMB_EEP_I2C_EEPROM=y
CONFIG_EMB_EEP_I2C_EEPROM_BUS_NUM_EE1=2
CONFIG_KEX_EEP_BOOTCOUNTER=y
CONFIG_AHCI=y
CONFIG_SPL_TEXT_BASE=0x18010000
CONFIG_DISTRO_DEFAULTS=y
CONFIG_FIT=y
CONFIG_FIT_VERBOSE=y
CONFIG_OF_BOARD_SETUP=y
CONFIG_OF_STDOUT_VIA_ALIAS=y
CONFIG_BOOTCOMMAND="run hdpload; run distro_bootcmd"
CONFIG_MISC_INIT_R=y
CONFIG_VERSION_VARIABLE=y
CONFIG_SPL_BOARD_INIT=y
CONFIG_SPL_SEPARATE_BSS=y
CONFIG_SYS_MMCSD_RAW_MODE_U_BOOT_USE_SECTOR=y
CONFIG_SYS_MMCSD_RAW_MODE_U_BOOT_SECTOR=0x900
CONFIG_SPL_MPC8XXX_INIT_DDR_SUPPORT=y
CONFIG_SPL_SPI_LOAD=y
CONFIG_SYS_SPI_U_BOOT_OFFS=0x26000
CONFIG_CMD_ASKENV=y
CONFIG_CMD_GREPENV=y
CONFIG_CMD_MD5SUM=y
CONFIG_MD5SUM_VERIFY=y
CONFIG_CMD_MEMTEST=y
CONFIG_CMD_DM=y
CONFIG_CMD_GPT=y
CONFIG_CMD_I2C=y
CONFIG_CMD_MMC=y
CONFIG_CMD_PCI=y
CONFIG_CMD_USB=y
CONFIG_CMD_WDT=y
CONFIG_CMD_CACHE=y
CONFIG_HASH_VERIFY=y
CONFIG_CMD_CRAMFS=y
CONFIG_OF_CONTROL=y
CONFIG_OF_BOARD_FIXUP=y
CONFIG_SPL_OF_CONTROL=y
CONFIG_DEFAULT_DEVICE_TREE="kontron_sl28"
CONFIG_ENV_IS_IN_SPI_FLASH=y
CONFIG_SYS_REDUNDAND_ENVIRONMENT=y
CONFIG_ENV_ADDR=0x203e0000
CONFIG_NET_RANDOM_ETHADDR=y
CONFIG_NETCONSOLE=y
CONFIG_DM=y
CONFIG_SPL_DM=y
CONFIG_SPL_DM_SEQ_ALIAS=y
CONFIG_SCSI_AHCI=y
CONFIG_SATA_CEVA=y
CONFIG_FSL_CAAM=y
CONFIG_SYS_FSL_DDR3=y
CONFIG_DM_I2C=y
CONFIG_I2C_SET_DEFAULT_BUS_NUM=y
CONFIG_DM_MMC=y
CONFIG_FSL_ESDHC=y
CONFIG_DM_SPI_FLASH=y
CONFIG_SPI_FLASH_ATMEL=y
CONFIG_SPI_FLASH_MACRONIX=y
CONFIG_SPI_FLASH_SPANSION=y
CONFIG_SPI_FLASH_WINBOND=y
# CONFIG_SPI_FLASH_USE_4K_SECTORS is not set
CONFIG_PHYLIB=y
CONFIG_PHY_ATHEROS=y
CONFIG_DM_ETH=y
CONFIG_DM_MDIO=y
CONFIG_PHY_GIGE=y
CONFIG_FSL_ENETC=y
CONFIG_NVME=y
CONFIG_PCI=y
CONFIG_DM_PCI=y
CONFIG_DM_PCI_COMPAT=y
CONFIG_PCIE_ECAM_GENERIC=y
CONFIG_PCIE_LAYERSCAPE=y
CONFIG_DM_RTC=y
CONFIG_RTC_RV8803=y
CONFIG_SCSI=y
CONFIG_DM_SCSI=y
CONFIG_DM_SERIAL=y
CONFIG_FSL_LPUART=y
CONFIG_SYS_NS16550=y
CONFIG_SPI=y
CONFIG_DM_SPI=y
CONFIG_FSL_DSPI=y
CONFIG_NXP_FSPI=y
CONFIG_USB=y
CONFIG_DM_USB=y
CONFIG_USB_XHCI_HCD=y
CONFIG_USB_XHCI_DWC3=y
CONFIG_DM_VIDEO=y
CONFIG_WDT=y
CONFIG_WDT_SP805=y
CONFIG_WDT_SL28CPLD=y
CONFIG_FS_CRAMFS=y
CONFIG_OF_LIBFDT_OVERLAY=y
CONFIG_EFI_LOADER_BOUNCE_BUFFER=y
```
